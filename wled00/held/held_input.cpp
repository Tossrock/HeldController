// AI: below section was generated by an AI
/*
 * Held — optional directly wired piece sensors.
 *
 * In the installation the six pocket sensors are read by the audio "brain" ESP32, which sends
 * the seated count over the serial link (held_link.h, UART set up in held_wled.cpp). This module
 * is only for a standalone setup with hall sensors wired to this board.
 *
 * List the GPIOs in build flags, one per piece, e.g.
 *   -D HELD_SENSOR_PINS=25,26,27,14,4,13
 * Sensors are read as active-low with the internal pull-up (typical open-drain hall switch);
 * define HELD_SENSOR_ACTIVE_HIGH to invert. With no pins defined this module does nothing.
 * Don't use the audio link pins (HELD_LINK_RX / HELD_LINK_TX, default 32 / 33).
 */
#include "../wled.h"
#include "held.h"

#ifdef WLED_ENABLE_HELD
#ifndef ARDUINO_ARCH_ESP32
  #error "Held requires an ESP32 (FreeRTOS)"
#endif

#ifdef HELD_SENSOR_PINS
static const int8_t sensorPins[] = { HELD_SENSOR_PINS };
static constexpr uint8_t NUM_SENSORS = sizeof(sensorPins) / sizeof(sensorPins[0]);
static_assert(NUM_SENSORS <= 12, "Held supports at most 12 piece sensors");
static constexpr unsigned long DEBOUNCE_MS = 30;

static bool sensorOk[NUM_SENSORS];
static uint32_t rawMask = 0;
static uint32_t stableMask = 0;
static unsigned long rawChanged = 0;

static uint32_t readSensors() {
  uint32_t m = 0;
  for (uint8_t i = 0; i < NUM_SENSORS; i++) {
    if (!sensorOk[i]) continue;
    bool level = digitalRead(sensorPins[i]);
    #ifdef HELD_SENSOR_ACTIVE_HIGH
    if (level) m |= 1UL << i;
    #else
    if (!level) m |= 1UL << i;
    #endif
  }
  return m;
}
#endif

void heldInputSetup() {
#ifdef HELD_SENSOR_PINS
  for (uint8_t i = 0; i < NUM_SENSORS; i++) {
    sensorOk[i] = sensorPins[i] >= 0 && PinManager::allocatePin(sensorPins[i], false, PinOwner::UM_Unspecified);
    if (!sensorOk[i]) { DEBUG_PRINTF_P(PSTR("Held: sensor pin %d unavailable\n"), sensorPins[i]); continue; }
    #ifdef HELD_SENSOR_ACTIVE_HIGH
    pinMode(sensorPins[i], INPUT);
    #else
    pinMode(sensorPins[i], INPUT_PULLUP);
    #endif
  }
  rawMask = stableMask = readSensors();
  heldSetPieces(stableMask);
#endif
}

void heldInputLoop() {
#ifdef HELD_SENSOR_PINS
  uint32_t m = readSensors();
  if (m != rawMask) { rawMask = m; rawChanged = millis(); }
  // only report edges, so pieces set from the web UI stay until a sensor actually changes
  if (rawMask != stableMask && millis() - rawChanged >= DEBOUNCE_MS) {
    stableMask = rawMask;
    heldSetPieces(stableMask);
  }
#endif
  // TODO(audio board): poll a dedicated link here once the protocol is agreed.
}
#endif // WLED_ENABLE_HELD
// AI: end
