// AI: below section was generated by an AI
/*
 * Held — WLED integration: the "Held" effect, the JSON API and persistence (/held.json).
 */
#include "../wled.h"
#include "held.h"
#include "held_core.h"
#include "held_link.h"

#ifdef WLED_ENABLE_HELD
#ifndef ARDUINO_ARCH_ESP32
  #error "Held requires an ESP32 (FreeRTOS)"
#endif

using namespace held;

static Engine engine;
static Link audioLink(engine);   // serial messages from the audio brain (see held_link.h)
static std::vector<hf> renderBuf;
static uint8_t fxId = 255;
static bool playing = true;
static float timeScale = 1.0f;
static bool autoApply = true;      // keep every segment on the Held effect
static bool frameInit = false;
static unsigned long lastFrame = 0;
static unsigned long lastSegCheck = 0;
static bool needsSave = false;
static char exprError[96] = "";    // last rejected expression, reported once in the next held JSON

static constexpr float MAX_FRAME_DT = 0.1f;             // s; longer stalls (FS writes, OTA) don't jump the animation
static constexpr unsigned long SEG_CHECK_INTERVAL = 1000; // ms
static constexpr TickType_t LOCK_WAIT = pdMS_TO_TICKS(50);
static constexpr uint8_t JSON_LOCK_HELD = 40;

// Audio brain link: UART1, 8N1 (held-electronics/docs/Held_Lighting_Serial_Messages.md).
// Wire brain GPIO4 (TX) -> RX pin, brain GPIO18 (RX) <- TX pin, and GND. The build flags are the
// first-boot defaults; pins and baud set at runtime ({"held":{"hw":{...}}}) are kept in /held_hw.json.
// -1 disables a pin.
#ifndef HELD_LINK_RX
  #define HELD_LINK_RX 32
#endif
#ifndef HELD_LINK_TX
  #define HELD_LINK_TX 33
#endif
#ifndef HELD_LINK_BAUD
  #define HELD_LINK_BAUD 115200
#endif
static HardwareSerial& linkSerial = Serial1;
static bool linkRx = false, linkTx = false;   // UART pins currently allocated and running
static int8_t linkRxPin = HELD_LINK_RX, linkTxPin = HELD_LINK_TX;
static uint32_t linkBaud = HELD_LINK_BAUD;
static char linkError[48] = "";
static bool linkReconfig = false;              // new pins requested; applied on the main loop
static int8_t newRxPin, newTxPin;
static uint32_t newBaud;
static bool hwNeedsSave = false;
static unsigned long lastLinkPoll = 0, lastLinkRetry = 0;
static constexpr unsigned long LINK_POLL_INTERVAL = 50;     // ms; beat-timeout check
static constexpr unsigned long LINK_RETRY_INTERVAL = 5000;  // ms; retry pins that were busy (e.g. until LEDs move off them)
static constexpr uint32_t LINK_BAUD_MIN = 1200, LINK_BAUD_MAX = 2000000;
static const char HELD_HW_FILE[] PROGMEM = "/held_hw.json";

static const char HELD_FILE[] PROGMEM = "/held.json";
static const char _data_FX_MODE_HELD[] PROGMEM = "Held@;;;1";

// The engine is touched from the main loop (rendering) and from the async web server task
// (JSON commands), so access is serialised. The renderer never waits: if a command holds the
// lock it simply keeps the previous frame.
static SemaphoreHandle_t engineMutex = nullptr;

class EngineLock {
  public:
    explicit EngineLock(TickType_t wait) { _ok = engineMutex && xSemaphoreTake(engineMutex, wait) == pdTRUE; }
    ~EngineLock() { if (_ok) xSemaphoreGive(engineMutex); }
    bool ok() const { return _ok; }
  private:
    bool _ok;
};

// ------------------------------------------------------------------ effect
static void advanceTo(unsigned long now) {
  if (!frameInit) { lastFrame = now; frameInit = true; return; }
  if (now == lastFrame) return;  // already ticked for this frame (several segments share it)
  float dt = (now - lastFrame) * 0.001f;
  lastFrame = now;
  if (dt > MAX_FRAME_DT) dt = MAX_FRAME_DT;
  if (playing) engine.tick(dt * timeScale);
}

static void mode_held() {
  EngineLock lock(0);
  if (!lock.ok()) return;
  advanceTo(strip.now);
  unsigned si = strip.getCurrSegmentId();
  unsigned len = SEGLEN;
  if (si >= (unsigned)MAX_STRIPS) { SEGMENT.fill(BLACK); return; }
  if (si >= engine.stripCount()) engine.setStripCount(si + 1);
  if (engine.stripLeds(si) != (int)len) engine.setStripParam(si, Sp::leds, len);
  renderBuf.resize(3 * len);
  engine.render(si, renderBuf.data());
  const hf* p = renderBuf.data();
  for (unsigned i = 0; i < len; i++, p += 3) {
    SEGMENT.setPixelColor(i, RGBW32(uint8_t(p[0] * 255.0f + 0.5f), uint8_t(p[1] * 255.0f + 0.5f), uint8_t(p[2] * 255.0f + 0.5f), 0));
  }
}

// ------------------------------------------------------------------ JSON helpers
static hf jsonNum(JsonVariant v, const ParamDef& d) {
  if (v.is<const char*>()) {
    const char* s = v.as<const char*>();
    if (d.type == PT_COLOR) return (hf)strtoul(s[0] == '#' ? s + 1 : s, nullptr, 16);
    return (hf)atof(s);
  }
  if (v.is<bool>()) return v.as<bool>() ? 1 : 0;
  return v.as<float>();
}

// a JSON [start, end] pair makes the param follow the piece level; returns whether it was a pair
static bool readParam(JsonVariant v, const ParamDef& d, hf& a, hf& b) {
  if (v.is<JsonArray>()) {
    JsonArray arr = v.as<JsonArray>();
    a = jsonNum(arr[0], d);
    b = arr.size() > 1 ? jsonNum(arr[1], d) : a;
    return true;
  }
  a = b = jsonNum(v, d);
  return false;
}

static void writeParam(JsonObject o, const ParamDef& d, hf a, hf b, bool ranged) {
  if (d.type == PT_COLOR) {
    char buf[8];
    snprintf_P(buf, sizeof(buf), PSTR("#%06X"), (unsigned)a);
    o[d.key] = buf;  // char[] is copied
  } else if (ranged) {
    JsonArray arr = o.createNestedArray(d.key);
    arr.add(a);
    arr.add(b);
  } else if (d.type == PT_FLOAT) {
    o[d.key] = a;
  } else if (d.type == PT_BOOL) {
    o[d.key] = a != 0;
  } else {
    o[d.key] = (int)a;
  }
}

static void writeConfig(JsonObject root) {
  JsonObject params = root.createNestedObject(F("params"));
  for (int g = 0; g < GRP_COUNT; g++) {
    JsonObject grp = params.createNestedObject(GROUPS[g].key);
    for (int i = 0; i < GROUPS[g].count; i++) {
      const char* expr = engine.paramExpr(g, i);
      if (expr) { grp[GROUPS[g].defs[i].key] = const_cast<char*>(expr); continue; }  // char* is copied
      ParamVal v = engine.getParam(g, i);
      writeParam(grp, GROUPS[g].defs[i], v.a, v.b, v.ranged);
    }
  }
  JsonArray strips = root.createNestedArray(F("strips"));
  for (int s = 0; s < MAX_STRIPS; s++) {
    if (s >= engine.stripCount() && s > 0) break;
    JsonObject st = strips.createNestedObject();
    for (int i = 0; i < Sp::COUNT; i++) {
      hf v = engine.getStripParam(s, i);
      writeParam(st, STRIP_DEFS[i], v, v, false);
    }
  }
  root[F("autoApply")] = autoApply;
}

static bool applyCommand(JsonObject h) {
  bool cfgChanged = false;

  JsonObject params = h[F("params")];
  for (JsonPair grp : params) {
    int g = findGroup(grp.key().c_str());
    if (g < 0 || !grp.value().is<JsonObject>()) continue;
    for (JsonPair kv : grp.value().as<JsonObject>()) {
      int i = findParam(GROUPS[g].defs, GROUPS[g].count, kv.key().c_str());
      if (i < 0) continue;
      const ParamDef& d = GROUPS[g].defs[i];
      if (kv.value().is<const char*>() && (d.type == PT_FLOAT || d.type == PT_INT)) {
        // a string on a numeric param is an expression, e.g. "(pieces, t) => 50 + 10 * wave(t / 3)"
        char err[64];
        if (engine.setParamExpr(g, i, kv.value().as<const char*>(), err, sizeof(err))) cfgChanged = true;
        else snprintf_P(exprError, sizeof(exprError), PSTR("%s.%s: %s"), GROUPS[g].key, d.key, err);
        continue;
      }
      hf a, b;
      bool ranged = readParam(kv.value(), d, a, b);
      engine.setParam(g, i, a, b, ranged);
      cfgChanged = true;
    }
  }

  JsonArray strips = h[F("strips")];
  int s = 0;
  for (JsonVariant sv : strips) {
    if (s >= MAX_STRIPS) break;
    for (JsonPair kv : sv.as<JsonObject>()) {
      int i = findParam(STRIP_DEFS, Sp::COUNT, kv.key().c_str());
      if (i < 0 || i == Sp::leds) continue;  // LED count comes from the segment
      hf a, b;
      readParam(kv.value(), STRIP_DEFS[i], a, b);
      engine.setStripParam(s, i, a);
      cfgChanged = true;
    }
    s++;
  }

  if (h[F("defaults")] | false) {
    engine.setDefaults();
    // keep the segment-derived LED counts
    int leds[MAX_STRIPS];
    for (int i = 0; i < MAX_STRIPS; i++) leds[i] = engine.stripLeds(i);
    engine.setStripDefaults();
    for (int i = 0; i < engine.stripCount(); i++) engine.setStripParam(i, Sp::leds, leds[i]);
    cfgChanged = true;
  }
  if (h.containsKey(F("autoApply"))) { autoApply = h[F("autoApply")]; cfgChanged = true; }

  if (h[F("reset")] | false) engine.reset();
  if (h.containsKey(F("play"))) playing = h[F("play")];
  if (h.containsKey(F("timeScale"))) timeScale = constrain(h[F("timeScale")].as<float>(), 0.0f, 8.0f);

  if (h.containsKey(F("mask"))) engine.setPieces(h[F("mask")].as<uint32_t>());
  else if (h.containsKey(F("pieces"))) {
    int n = constrain(h[F("pieces")].as<int>(), 0, 31);
    engine.setPieces((1UL << n) - 1);
  }

  if (h[F("clear")] | false) engine.clearEvents();
  JsonVariant cancel = h[F("cancel")];
  if (cancel.is<const char*>()) { int e = findEvent(cancel.as<const char*>()); if (e >= 0) engine.cancel(e); }
  JsonVariant trig = h[F("trigger")];
  if (trig.is<const char*>()) { int e = findEvent(trig.as<const char*>()); if (e >= 0) engine.trigger(e); }
  else if (trig.is<JsonArray>()) {
    for (JsonVariant t : trig.as<JsonArray>()) { int e = findEvent(t | ""); if (e >= 0) engine.trigger(e); }
  }

  // "link": a line (or array of lines) handled exactly as if it came from the audio brain
  JsonVariant linkLines = h[F("link")];
  if (linkLines.is<const char*>()) audioLink.handleLine(linkLines.as<const char*>(), millis());
  else if (linkLines.is<JsonArray>()) {
    for (JsonVariant v : linkLines.as<JsonArray>()) if (v.is<const char*>()) audioLink.handleLine(v.as<const char*>(), millis());
  }

  // "hw": audio link pins / baud; applied and saved on the main loop (the UART is read there)
  JsonObject hwCmd = h[F("hw")];
  if (!hwCmd.isNull()) {
    newRxPin = constrain((int)(hwCmd[F("linkRx")] | (int)linkRxPin), -1, WLED_NUM_PINS - 1);
    newTxPin = constrain((int)(hwCmd[F("linkTx")] | (int)linkTxPin), -1, WLED_NUM_PINS - 1);
    newBaud = constrain((uint32_t)(hwCmd[F("linkBaud")] | linkBaud), LINK_BAUD_MIN, LINK_BAUD_MAX);
    linkReconfig = true;
  }

  if (h[F("save")] | false) needsSave = true;
  return cfgChanged;
}

// ------------------------------------------------------------------ public API
bool heldDeserialize(JsonObject h) {
  EngineLock lock(LOCK_WAIT);
  if (!lock.ok()) return false;
  return applyCommand(h);
}

void heldSerialize(JsonObject root, bool full) {
  EngineLock lock(LOCK_WAIT);
  if (!lock.ok()) { root[F("error")] = F("busy"); return; }
  root[F("v")] = 1;
  root[F("fx")] = fxId;
  root[F("playing")] = playing;
  root[F("timeScale")] = timeScale;
  root[F("autoApply")] = autoApply;
  root[F("bri")] = bri;
  root[F("level")] = engine.level();
  root[F("mask")] = engine.mask();
  root[F("count")] = engine.count();
  root[F("numPieces")] = (int)engine.getParam(GRP_GLOBAL, Gp::numPieces).a;
  bool active = strip.getSegmentsNum() > 0;
  for (unsigned s = 0; s < strip.getSegmentsNum(); s++) {
    const Segment& seg = strip.getSegment(s);
    if (seg.isActive() && seg.mode != fxId) active = false;
  }
  root[F("active")] = active;
  {
    const LinkStatus& ls = audioLink.status();
    uint32_t now = millis();
    JsonObject lo = root.createNestedObject(F("link"));
    lo[F("uart")] = linkRx;
    lo[F("rx")] = linkRxPin;
    lo[F("tx")] = linkTxPin;
    lo[F("txOn")] = linkTx;
    lo[F("baud")] = linkBaud;
    if (linkError[0]) lo[F("error")] = (char*)linkError;  // copied
    lo[F("ext")] = engine.externalClock();
    lo[F("lineAgo")] = ls.lastLineMs ? (long)(now - ls.lastLineMs) : -1L;
    lo[F("beatAgo")] = ls.lastBeatMs ? (long)(now - ls.lastBeatMs) : -1L;
    lo[F("lines")] = ls.lines;
    lo[F("unknown")] = ls.unknown;
    lo[F("beats")] = ls.beats;
    lo[F("missed")] = ls.missed;
    lo[F("beat")] = ls.beatN;
    lo[F("bpm")] = ls.bpm;
    lo[F("dub")] = ls.dubMs;
    lo[F("next")] = ls.nextMs;
    lo[F("seated")] = ls.seated;
    lo[F("required")] = ls.required;
    lo[F("story")] = ls.story;
    lo[F("playing")] = ls.storyPlaying;
    lo[F("last")] = (char*)ls.last;  // copied
  }
  if (exprError[0]) {
    root[F("exprError")] = (char*)exprError;  // copied
    exprError[0] = 0;
  }
  JsonArray events = root.createNestedArray(F("events"));
  for (uint8_t e = 0; e < engine.eventCount(); e++) {
    EventInfo ei = engine.eventInfo(e);
    JsonObject o = events.createNestedObject();
    o["t"] = EVENT_NAMES[ei.type];
    o[F("age")] = ei.age;
    o[F("dur")] = ei.duration;
  }
  if (!full) return;
  writeConfig(root);
  JsonArray strips = root[F("strips")];
  for (unsigned s = 0; s < strips.size() && s < strip.getSegmentsNum(); s++) {
    strips[s][F("start")] = strip.getSegment(s).start;  // where this strip begins in the global LED index (for live view)
  }
  // LED strip types the UI offers for the outputs (WLED's own LED config does the rest; see /json/cfg)
  JsonArray types = root.createNestedArray(F("ledTypes"));
  for (const LEDType& t : BusDigital::getLEDTypes()) {
    JsonObject o = types.createNestedObject();
    o["i"] = t.id;
    o["n"] = t.name;  // static string
    o["p"] = Bus::is2Pin(t.id) ? 2 : 1;
  }
}

void heldSetPieces(uint32_t mask) {
  EngineLock lock(LOCK_WAIT);
  if (lock.ok()) engine.setPieces(mask);
}

uint32_t heldGetPieces() { return engine.mask(); }

bool heldTrigger(const char* eventName) {
  int e = findEvent(eventName);
  if (e < 0) return false;
  EngineLock lock(LOCK_WAIT);
  return lock.ok() && engine.trigger(e);
}

// ------------------------------------------------------------------ persistence
static void saveConfig() {
  if (!requestJSONBufferLock(JSON_LOCK_HELD)) { needsSave = true; return; }
  JsonObject root = pDoc->to<JsonObject>();
  {
    EngineLock lock(LOCK_WAIT);
    if (lock.ok()) writeConfig(root);
  }
  File f = WLED_FS.open(FPSTR(HELD_FILE), "w");
  if (f) {
    serializeJson(root, f);
    f.close();
    DEBUG_PRINTLN(F("Held: config saved"));
  }
  releaseJSONBufferLock();
}

static void loadConfig() {
  if (!WLED_FS.exists(FPSTR(HELD_FILE))) return;
  if (!requestJSONBufferLock(JSON_LOCK_HELD)) return;
  File f = WLED_FS.open(FPSTR(HELD_FILE), "r");
  if (f) {
    DeserializationError err = deserializeJson(*pDoc, f);
    f.close();
    if (!err) {
      EngineLock lock(LOCK_WAIT);
      if (lock.ok()) applyCommand(pDoc->as<JsonObject>());
      DEBUG_PRINTLN(F("Held: config loaded"));
    }
  }
  releaseJSONBufferLock();
}

// ------------------------------------------------------------------ audio brain link
static void linkSetup() {
  int8_t rx = linkRxPin, tx = linkTxPin;
  linkError[0] = 0;
  if (rx < 0) { strcpy_P(linkError, PSTR("disabled (no RX pin)")); return; }
  if (!PinManager::allocatePin(rx, false, PinOwner::UM_Unspecified)) {
    snprintf_P(linkError, sizeof(linkError), PSTR("RX GPIO%d unavailable or in use"), rx);
    DEBUG_PRINTF_P(PSTR("Held: audio link %s\n"), linkError);
    return;
  }
  if (tx >= 0 && !PinManager::allocatePin(tx, true, PinOwner::UM_Unspecified)) {
    snprintf_P(linkError, sizeof(linkError), PSTR("TX GPIO%d unavailable or in use; receive only"), tx);
    DEBUG_PRINTF_P(PSTR("Held: audio link %s\n"), linkError);
    tx = -1;
  }
  linkSerial.begin(linkBaud, SERIAL_8N1, rx, tx);
  linkRx = true;
  linkTx = tx >= 0;
  EngineLock lock(LOCK_WAIT);
  if (lock.ok()) {
    audioLink.queueReply("HELLO");   // a brain that answers with COUNT lets the lights resync after a reboot
    audioLink.queueReply("LOG Held lighting ready");
  }
}

static void linkTeardown() {
  if (linkRx) linkSerial.end();
  if (linkRx) PinManager::deallocatePin(linkRxPin, PinOwner::UM_Unspecified);
  if (linkTx) PinManager::deallocatePin(linkTxPin, PinOwner::UM_Unspecified);
  linkRx = linkTx = false;
}

static void saveHw() {
  if (!requestJSONBufferLock(JSON_LOCK_HELD)) { hwNeedsSave = true; return; }
  JsonObject root = pDoc->to<JsonObject>();
  root[F("linkRx")] = linkRxPin;
  root[F("linkTx")] = linkTxPin;
  root[F("linkBaud")] = linkBaud;
  File f = WLED_FS.open(FPSTR(HELD_HW_FILE), "w");
  if (f) { serializeJson(root, f); f.close(); }
  releaseJSONBufferLock();
}

static void loadHw() {
  if (!WLED_FS.exists(FPSTR(HELD_HW_FILE))) return;
  if (!requestJSONBufferLock(JSON_LOCK_HELD)) return;
  File f = WLED_FS.open(FPSTR(HELD_HW_FILE), "r");
  if (f) {
    if (!deserializeJson(*pDoc, f)) {
      JsonObject root = pDoc->as<JsonObject>();
      linkRxPin = constrain((int)(root[F("linkRx")] | (int)linkRxPin), -1, WLED_NUM_PINS - 1);
      linkTxPin = constrain((int)(root[F("linkTx")] | (int)linkTxPin), -1, WLED_NUM_PINS - 1);
      linkBaud = constrain((uint32_t)(root[F("linkBaud")] | linkBaud), LINK_BAUD_MIN, LINK_BAUD_MAX);
    }
    f.close();
  }
  releaseJSONBufferLock();
}

// pin changes requested over JSON, saving, and retrying pins that were busy
static void linkMaintain() {
  if (linkReconfig) {
    linkReconfig = false;
    linkTeardown();
    linkRxPin = newRxPin;
    linkTxPin = newTxPin;
    linkBaud = newBaud;
    linkSetup();
    hwNeedsSave = true;
  }
  if (hwNeedsSave) {
    hwNeedsSave = false;
    saveHw();
  }
  if (!linkRx && linkRxPin >= 0 && millis() - lastLinkRetry > LINK_RETRY_INTERVAL) {
    lastLinkRetry = millis();
    linkSetup();
  }
}

// Read the UART, run the beat timeout, and send replies. Lines take ~2 ms each at 115200 baud;
// the UART buffers them between main-loop iterations.
static void linkLoop() {
  bool pending = linkRx && linkSerial.available();
  if (!pending && millis() - lastLinkPoll < LINK_POLL_INTERVAL) return;
  lastLinkPoll = millis();
  char out[LINK_REPLY_MAX][LINK_LINE_MAX];
  int nOut = 0;
  {
    EngineLock lock(LOCK_WAIT);
    if (!lock.ok()) return;
    uint32_t now = millis();
    if (linkRx) while (linkSerial.available()) audioLink.feed((char)linkSerial.read(), now);
    audioLink.poll(now);
    while (nOut < LINK_REPLY_MAX && audioLink.popReply(out[nOut], LINK_LINE_MAX)) nOut++;
  }
  if (!linkTx) return;
  for (int i = 0; i < nOut; i++) { linkSerial.print(out[i]); linkSerial.print('\n'); }
}

// keep the engine's strip count in line with the segments, and (optionally) every segment on Held
static void checkSegments() {
  unsigned n = 0;
  for (unsigned s = 0; s < strip.getSegmentsNum(); s++) {
    Segment& seg = strip.getSegment(s);
    if (!seg.isActive()) continue;
    n++;
    if (autoApply && fxId != 255 && seg.mode != fxId) {
      seg.setMode(fxId);
      stateChanged = true;
    }
  }
  if (n > (unsigned)MAX_STRIPS) n = MAX_STRIPS;
  EngineLock lock(LOCK_WAIT);
  if (lock.ok() && n > 0 && n != engine.stripCount()) engine.setStripCount(n);
}

void heldSetup() {
  engineMutex = xSemaphoreCreateMutex();
  fxId = strip.addEffect(255, &mode_held, _data_FX_MODE_HELD);
  DEBUG_PRINTF_P(PSTR("Held: effect id %u\n"), fxId);
  loadConfig();
  heldInputSetup();
  loadHw();
  linkSetup();
  checkSegments();
}

void heldLoop() {
  heldInputLoop();
  linkMaintain();
  linkLoop();
  if (needsSave) {
    needsSave = false;
    saveConfig();
  }
  if (millis() - lastSegCheck > SEG_CHECK_INTERVAL) {
    lastSegCheck = millis();
    checkSegments();
  }
}
#endif // WLED_ENABLE_HELD
// AI: end
